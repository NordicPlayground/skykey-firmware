## Kconfig
```kconfig
#
# Copyright (c) 2021 Nordic Semiconductor ASA
#
# SPDX-License-Identifier: LicenseRef-Nordic-5-Clause
#

menu "Skykey Firmware"

config SKYKEY_FW_VERSION
    string "Firmware version"
    default "0.0.0"

config SKYKEY_BOARD_VERSION
    string "Board version"
    default "0.0.0"

rsource "src/modules/Kconfig"

rsource "src/events/Kconfig"

rsource "src/util/Kconfig"

rsource "drivers/Kconfig"
endmenu

menu "Zephyr Kernel"
source "Kconfig.zephyr"
endmenu

module = APPLICATION_MODULE
module-str = Application module
source "subsys/logging/Kconfig.template.log_config"
```

## common/Kconfig/Kconfig
```kconfig
# Common configurations for the nRF9160 and nRF52840
menu "Common"
config SKYKEY_FW_VERSION
    string "Firmware version"
    default "0.0.0"

config SKYKEY_BOARD_VERSION
    string "Board version"
    default "0.0.0"

endmenu
```

## drivers/dfrobot_sen0348/Kconfig
```kconfig
menu "DFRobot_sen0348 fingerprint sensor"
config FINGERPRINT
    bool "Enable fingerprint sensor"
    default y
    depends on GPIO && (UART_INTERRUPT_DRIVEN || UART_ASYNC_API)

if FINGERPRINT

module = SEN0348_DRIVER
module-str = sen0348 driver
source "subsys/logging/Kconfig.template.log_config"

config FINGERPRINT_MAX_PACKET_SIZE
    int "Maximum packet size"
    default 26
    range 26 510

config FINGERPRINT_SYNC_BAUDRATE
    bool "Sync baud rate"
    help
       Enable to automatically sync the baud rate of the sensor module to the baud rate of the uart bus.
       Causes driver initialization to take up to 1.4 seconds extra per sensor, so disabling this is 
       recommended once the baud rate has been configured once. Might not be supported by all uart drivers.

config FINGERPRINT_UART_BUFFER_SIZE
    int "Buffer size"
    range 32 65536
    default 32 
    depends on FINGERPRINT
    help 
        Size of uart buffers used for recieving and transmitting sensor messages. 
        Should be 512 if the module needs to up- or download files.
        Can be safely reduced to 32 if not. Behaviour if moving files with a buffer
        size < 512 is undefined. 

config FINGERPRINT_UART_RECIEVE_BUFFER_COUNT
    int  "Recieve buffer count"
    default 2 if FINGERPRINT_UART_USE_ASYNC
    default 1 if !FINGERPRINT_UART_USE_ASYNC
    depends on FINGERPRINT
    help
      Number of buffers available for incomming uart data. Will be allocated for each device.

config FINGERPRINT_UART_TRANSMIT_BUFFER_COUNT
    int  "Fingerprint uart transmit buffer count"
    default 1
    depends on FINGERPRINT
    help
      Number of buffers available for command packets. Will be allocated for each device.
endif
endmenu
```

## drivers/fingerprint/Kconfig
```kconfig
menu "Fingerprint sensor"
config FINGERPRINT
    bool "Enable fingerprint sensor"
    default n

if FINGERPRINT

rsource "*/Kconfig"


endif
endmenu
```

## nrf52840/Kconfig
```kconfig
menu "Skykey Firmware: nRF52840"

rsource "../common/Kconfig/Kconfig"

endmenu

menu "Zephyr Kernel"
source "Kconfig.zephyr"
endmenu

module = APPLICATION_MODULE
module-str = Application module
source "subsys/logging/Kconfig.template.log_config"
```

## nrf9160/Kconfig
```kconfig
#
# Copyright (c) 2021 Nordic Semiconductor ASA
#
# SPDX-License-Identifier: LicenseRef-Nordic-5-Clause
#

menu "Skykey Firmware: nRF9160"

rsource "../common/Kconfig/Kconfig"

rsource "src/modules/Kconfig"

rsource "src/events/Kconfig"

rsource "src/util/Kconfig"

rsource "drivers/Kconfig"
endmenu

menu "Zephyr Kernel"
source "Kconfig.zephyr"
endmenu

module = APPLICATION_MODULE
module-str = Application module
source "subsys/logging/Kconfig.template.log_config"
```

## nrf9160/drivers/fingerprint/dfrobot_sen0348/Kconfig
```kconfig
config SEN0348
    bool "Enable SEN0348 fingerprint module driver"
    depends on UART_INTERRUPT_DRIVEN && GPIO

if SEN0348

module = SEN0348_DRIVER
module-str = sen0348 driver
source "subsys/logging/Kconfig.template.log_config"

config SEN0348_MAX_PACKET_SIZE
    int "Maximum packet size"
    default 26
    range 26 510

config SEN0348_SYNC_BAUDRATE
    bool "Sync baud rate"
    help
       Enable to automatically sync the baud rate of the sensor module to the baud rate of the uart bus.
       Causes driver initialization to take up to 1.4 seconds extra per sensor, so disabling this is 
       recommended once the baud rate has been configured once. Might not be supported by all uart drivers.

config SEN0348_UART_BUFFER_SIZE
    int "Buffer size"
    range 32 65536
    default 32 
    depends on SEN0348
    help 
        Size of uart buffers used for recieving and transmitting sensor messages. 
        Should be 512 if the module needs to up- or download files.
        Can be safely reduced to 32 if not. Behaviour if moving files with a buffer
        size < 512 is undefined. 

config SEN0348_UART_RECIEVE_BUFFER_COUNT
    int  "Recieve buffer count"
    default 1
    depends on SEN0348
    help
      Number of buffers available for incomming uart data. Will be allocated for each device.

config SEN0348_UART_TRANSMIT_BUFFER_COUNT
    int  "Fingerprint uart transmit buffer count"
    default 1
    depends on SEN0348
    help
      Number of buffers available for command packets. Will be allocated for each device.

endif
```

## nrf9160/dts/bindings/dfrobot,sen0348.yaml
```yaml
description: |
  DFRobot sen0348 fingerprint sensor

compatible: "dfrobot,sen0348"

include: uart-device.yaml

properties:
  int-gpios:
    required: true 
    type: phandle-array
    description: |
      "Pin used for IRQ."
  power-gpios:
    required: false
    type: phandle-array
    description: |
      "Pin used for switchable power supply."
  sensor-id:
    required: false
    type: int
    default: 0
    description: |
      "Id of sensor module. Can be in range 0-255."
  controller-id:
    required: false
    type: int
    default: 0
    description: |
      "Id of controlling device. Can be in range 0-255."
```

## nrf9160/src/modules/Kconfig.cloud_module
```kconfig
# TODO: Set up proper select and/or depends on clauses
menuconfig CLOUD_MODULE
    bool "Enable cloud module"
    default y
    help
        Enables cloud module.
    
if CLOUD_MODULE
    config CLOUD_THREAD_STACK_SIZE
    int "Cloud module thread stack size"
    default 2560

    config CLOUD_CONNECT_RETRIES
    int "Cloud connection retries"
    default 16
    help
      Maximum number of cloud connection retries.

    config CLOUD_DOWNLOAD_URL_MAX_LEN
    int "Maximum length for the URL entry of the shadow update"
    default 256
    

    module = CLOUD_MODULE
    module-str = Cloud module
    source "subsys/logging/Kconfig.template.log_config"
endif #CLOUD_MODULE
```

## nrf9160/src/modules/Kconfig.display_module
```kconfig
#
# Copyright (c) 2021 Nordic Semiconductor
#
# SPDX-License-Identifier: LicenseRef-Nordic-5-Clause
#

menuconfig DISPLAY_MODULE
    bool "Display module"
	default y
	select DISPLAY
	select LVGL
	select LVGL_USE_LABEL
	select LVGL_USE_CONT
	select LVGL_USE_BTN
	select LVGL_USE_PAGE
	select LVGL_USE_LIST
	select LVGL_USE_GROUP
	help
    Enables display module.

if DISPLAY_MODULE

config DISPLAY_DEV_NAME
    string "Display device name"
    default "ST7789V"

config DISPLAY_THREAD_STACK_SIZE
	int "Display module thread stack size"
	default 2560

config DISPLAY_LIST_ENTRY_MAX_NUM
	int "Upper bound for number of entries"
	default 10

config DISPLAY_LIST_ENTRY_MAX_LEN
	int "max entry length"
	default 20

# Display-specific settings

if ST7789V

config LVGL_DISPLAY_DEV_NAME
	default "ST7789V"

choice ST7789V_PIXEL_FORMAT
	default ST7789V_RGB565
endchoice

config LVGL_HOR_RES_MAX
	default 240

config LVGL_VER_RES_MAX
	default 240

config LVGL_BITS_PER_PIXEL
	default 16

choice LVGL_COLOR_DEPTH
	default LVGL_COLOR_DEPTH_16
endchoice

config LVGL_COLOR_16_SWAP
	default y

endif #ST7789V

if LVGL_USE_ANIMATION
	config DISPLAY_ANIMATION_TRANSITION_TIME_MSEC
	int "Transition time for screen loading"
	default 1000

endif #LVGL_USE_ANIMATION

module = DISPLAY_MODULE
module-str = Display module
source "subsys/logging/Kconfig.template.log_config"

endif #DISPLAY_MODULE
```

## nrf9160/src/modules/Kconfig.download_module
```kconfig
menuconfig DOWNLOAD_MODULE
    bool "Enable download module"
    default y
    help
        Enables download module.
    
if DOWNLOAD_MODULE
    config DOWNLOAD_THREAD_STACK_SIZE
    int "Download module thread stack size"
    default 4096

    config DOWNLOAD_FILE_MAX_SIZE_BYTES
    int "Maximum number of bytes for the file to download"
    default 2048

    config DOWNLOAD_STREAM_FLASH_DEBUG
    bool "Enable stream flash debugging"
    default y

    config DOWNLOAD_SOCKET_RETRIES
        int "Number of retries for socket-related download issues"
        default 2

    config DOWNLOAD_PROGRESS_EVT
        bool "Emit progress event upon receiving a download fragment"

    config DOWNLOAD_MODULE_SEC_TAG
        int "Download module TLS CA sec tag" if MODEM_MODULE_DOWNLOAD_CA_SEC_TAG < 0
        default MODEM_MODULE_DOWNLOAD_CA_SEC_TAG
        help
            Security tag representing the CA certificate used for authenticating
            and establishing an encrypted connection to the file host. Will by
            default use the certificate provisioned by the modem module.

    module = DOWNLOAD_MODULE
    module-str = Download module
    source "subsys/logging/Kconfig.template.log_config"
endif #DOWNLOAD_MODULE
```

## nrf9160/src/util/Kconfig
```kconfig
menuconfig FILE_UTIL
	bool "File reading/writing utils"
    default y

if FILE_UTIL

module = FILE_UTIL
module-str = File utilities
source "subsys/logging/Kconfig.template.log_config"
endif # FILE_UTIL

menuconfig PARSE_UTIL
    bool "Util for reading entries"
    default y

if PARSE_UTIL
module = PARSE_UTIL
module-str = Entry utilities
source "subsys/logging/Kconfig.template.log_config"
endif # PARSE_UTIL
```

## src/events/Kconfig
```kconfig
#
# Copyright (c) 2021 Nordic Semiconductor
#
# SPDX-License-Identifier: LicenseRef-Nordic-5-Clause
#

menuconfig EVENTS
	bool "Event options"
	default y

if EVENTS

config DISPLAY_EVENTS_LOG
	bool "Enable logging for display module events"
	default y

config CLOUD_EVENTS_LOG
	bool "Enable logging for cloud module events"
	default y

config PASSWORD_EVENTS_LOG
	bool "Enable logging for password module events"
	default y

endif
```

## src/modules/Kconfig
```kconfig
# Fingerprint sensor module config
config FINGERPRINT_UART_ID
	int "Fingerprint UART id"
	default 1
	range 0 1
	help
	  ID of UART device used to communicate with the fingerprint sensor. 

config FINGERPRINT_MODULE_ADDRESS
	hex "Fingerprint module address"
	default 0xFFFFFFFF
	range 0x0 0xFFFFFFFF
	help
	  Configured address of the fingerprint sensor module. Must corespond
	  to address programmed on the fingerprint sensor module.

# UART module config
config UART_DATA_EVENT_LOG_ENABLE
	bool "Log uart data events"
	default y

config UART_TRANSMIT_EVENT_LOG_ENABLE
	bool "Log uart transmit events"
	default y

config UART_LOG_LEVEL
	int "UART log level"
	default 0
	range 0 4
	help
	  Log level of the uart module.

config UART_BUF_SIZE
	int "UART buffer size"
	default 64
	help
	  Size of uart transmit/receive buffers.

config UART_BUF_COUNT
	int "UART buffer block count"
	default 3
	range 3 255
	help
	  Number of buffer blocks assigned for UART instances.
	  This value is scaled with the number of interfaces.
	  With the default instance count of 2, and for example 3 buffers,
	  the total will be 6 buffers.
	  Note that all buffers are shared between UART instances.
```

## src/modules/Kconfig.cloud_module
```kconfig
menuconfig CLOUD_MODULE
    bool "Enable cloud module"
    default y
    help
        Enables cloud module.
    
    if CLOUD_MODULE

    module = CLOUD_MODULE
    module-str = Cloud module
    source "subsys/logging/Kconfig.template.log_config"
    endif
```

## src/modules/Kconfig.display_module
```kconfig
#
# Copyright (c) 2021 Nordic Semiconductor
#
# SPDX-License-Identifier: LicenseRef-Nordic-5-Clause
#

menuconfig DISPLAY_MODULE
    bool "Display module"
    default y

if DISPLAY_MODULE

config DISPLAY_DEV_NAME
    string "Display device name"
    default "ST7789V"

config DISPLAY_THREAD_STACK_SIZE
	int "Display module thread stack size"
	default 2560

config SPI
    default y

if LVGL

config LVGL_DISPLAY_DEV_NAME
	default "ST7789V"

config LVGL_HOR_RES_MAX
	default 240

config LVGL_VER_RES_MAX
	default 240

config LVGL_BITS_PER_PIXEL
	default 16

choice LVGL_COLOR_DEPTH
	default LVGL_COLOR_DEPTH_16
endchoice

config LVGL_COLOR_16_SWAP
	default y

config LVGL_USE_LABEL
	default y

config LVGL_USE_IMG
	default y

config LVGL_USE_BTN
	default y



config LVGL_USE_ASSERT_OBJ
	default y

config LVGL_USE_ASSERT_STYLE
	default y

config LVGL_USE_ANIMATION
	default y

config LVGL_USE_OPA_SCALE
	default y

config LVGL_ANTIALIAS
	default y

endif # LVGL

endif #DISPLAY_MODULE

module = DISPLAY_MODULE
module-str = Display module
source "subsys/logging/Kconfig.template.log_config"
```

## src/modules/Kconfig.download_module
```kconfig
menuconfig DOWNLOAD_MODULE
    bool "Enable download module"
    default y
    help
        Enables download module.
    
if DOWNLOAD_MODULE
    config DOWNLOAD_THREAD_STACK_SIZE
    int "Download module thread stack size"
    default 4096

    config DOWNLOAD_FILE_MAX_SIZE_BYTES
    int "Maximum number of bytes for the file to download"
    default 2048

    config DOWNLOAD_STREAM_FLASH_DEBUG
    bool "Enable stream flash debugging"
    default y

    config DOWNLOAD_DOWNLOAD_SOCKET_RETRIES
        int "Number of retries for socket-related download issues"
        default 2

    config DOWNLOAD_DOWNLOAD_PROGRESS_EVT
        bool "Emit progress event upon receiving a download fragment"

    module = DOWNLOAD_MODULE
    module-str = Download module
    source "subsys/logging/Kconfig.template.log_config"
endif #DOWNLOAD_MODULE
```

## src/modules/Kconfig.fingerprint_module
```kconfig
menuconfig FINGERPRINT_MODULE
    bool "Enable password module"
    default y
    select FINGERPRINT
    select SEN0348
    help
        Enables fingerprint module.
    
if FINGERPRINT_MODULE

    module = FINGERPRINT_MODULE
    module-str = Fingerprint module
    source "subsys/logging/Kconfig.template.log_config"
endif #FINGERPRINT_MODULE
```

## src/modules/Kconfig.password_module
```kconfig
menuconfig PASSWORD_MODULE
    bool "Enable password module"
    default y
    help
        Enables password module.
    
if PASSWORD_MODULE
    config PASSWORD_THREAD_STACK_SIZE
    int "Password module thread stack size"
    default 2560

    config PASSWORD_ENTRY_NAME_MAX_LEN
    int "Maximum platform name length"
    default 20
    
    config PASSWORD_ENTRY_MAX_NUM
    int "Maximum number of entries (platforms) to support"
    default 10

    config PASSWORD_FILE_MAX_SIZE_BYTES
    int "Maximum number of bytes for the password file"
    default 2048


    module = PASSWORD_MODULE
    module-str = Password module
    source "subsys/logging/Kconfig.template.log_config"
endif #PASSWORD_MODULE
```

## src/util/Kconfig
```kconfig
menuconfig FILE_UTIL
	bool "External sensors"
    default y

if FILE_UTIL

module = FILE_UTIL
module-str = File utilities
source "subsys/logging/Kconfig.template.log_config"

endif # EXTERNAL_SENSORS
```

## west.yml
```yaml
manifest:
  version: "0.10"

  defaults:
    revision: main

  remotes:
    - name: nrfconnect
      url-base: https://github.com/nrfconnect/

  projects:
    - name: sdk-nrf
      remote: nrfconnect
      path: nrf
      revision: v1.6.0 
      import: true
      
  self:
    path: skykey-firmware/nrf9160
```
