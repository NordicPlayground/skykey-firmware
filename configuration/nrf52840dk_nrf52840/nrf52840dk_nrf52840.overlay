&uart1 {
	status = "okay";
	current-speed = <115200>;
	fingerprint_sensor: sen0348{
		compatible = "dfrobot,sen0348";
		label = "fingerprint_0";
		int-gpios = <&gpio1 3 GPIO_ACTIVE_HIGH>;
		power-gpios = <&gpio1 4 0>;
	};
};
